## conf/machine/genesyszu-5ev.conf
```bitbake
#@TYPE: Machine
#@NAME: genesyszu-5ev
#@DESCRIPTION: Machine configuration for the genesyszu-5ev boards.


BBMULTICONFIG += "genesyszu-5ev-cortexa53-fsbl genesyszu-5ev-microblaze-pmu"

#### Preamble
MACHINEOVERRIDES =. "${@['', 'genesyszu-5ev:']['genesyszu-5ev' !='${MACHINE}']}"
#### Regular settings follow
TUNEFILE[microblaze-pmu] = "conf/machine/include/genesyszu-5ev/microblaze.inc"

# First Stage Boot Loader
FSBL_DEPENDS = ""
FSBL_MCDEPENDS = "mc::genesyszu-5ev-cortexa53-fsbl:fsbl-firmware:do_deploy"
FSBL_DEPLOY_DIR = "${TMPDIR}-genesyszu-5ev-cortexa53-fsbl/deploy/images/${MACHINE}"

# PMU Firmware
PMU_DEPENDS = ""
PMU_MCDEPENDS = "mc::genesyszu-5ev-microblaze-pmu:pmu-firmware:do_deploy"
PMU_FIRMWARE_DEPLOY_DIR = "${TMPDIR}-genesyszu-5ev-microblaze-pmu/deploy/images/${MACHINE}"

# Set the default (linux) domain device tree
CONFIG_DTFILE_DIR := "${@bb.utils.which(d.getVar('BBPATH'), 'conf/dts/genesyszu-5ev')}"
CONFIG_DTFILE ?= "${CONFIG_DTFILE_DIR}/cortexa53-linux.dts"
CONFIG_DTFILE[vardepsexclude] += "CONFIG_DTFILE_DIR"

DTB_FILE_PATH ?= "${RECIPE_SYSROOT}/boot/devicetree/${@os.path.basename(d.getVar('CONFIG_DTFILE').replace('.dts', '.dtb'))}"

# Serial Console Settings
SERIAL_CONSOLES ?= "115200;ttyPS0"

# Yocto arm-trusted-firmware(TF-A) variables
TFA_CONSOLE ?= "cadence"
TFA_BL33_LOAD ?= "0x8000000"

# Yocto u-boot-xlnx variables

# Set DDR Base address for u-boot-xlnx-scr variables
DDR_BASEADDR ?= "0x0"
SKIP_APPEND_BASEADDR ?= "0"

# Yocto KERNEL Variables
UBOOT_ENTRYPOINT ?= "0x200000"
UBOOT_LOADADDRESS ?= "0x200000"

# Yocto MACHINE_FEATURES Variable
MACHINE_FEATURES += "mali400 efi"

# Required generic machine inclusion
require conf/machine/zynqmp-generic.conf

# This is an 'SDT' based BSP
XILINX_WITH_ESW = "sdt"

# Original SDT artifacts URL
SDT_URI = "git://github.com/Digilent/sdt.git;protocol=https;branch=zu/5ev/genesyszu/main;rev=234245326d62533805fd6ff5b942a17139923f38"
SDT_URI[S] = "${WORKDIR}/git/generated/sdt"

# Set the system device trees
SYSTEM_DTFILE_DEPENDS = "sdt-artifacts"
SYSTEM_DTFILE_DIR = "${RECIPE_SYSROOT}${datadir}/sdt/${MACHINE}"
SYSTEM_DTFILE = "${SYSTEM_DTFILE_DIR}/system-top.dts"

# Load the dynamic machine features
include conf/machine/include/genesyszu-5ev/${BB_CURRENT_MC}-features.conf
LIBXIL_CONFIG = "conf/machine/include/genesyszu-5ev/${BB_CURRENT_MC}-libxil.conf"

# zynqmp bitstream path 
BITSTREAM_PATH_DEPENDS = "sdt-artifacts"
BITSTREAM_PATH_DIR = "${RECIPE_SYSROOT}${datadir}/sdt/${MACHINE}"
BITSTREAM_PATH = "${BITSTREAM_PATH_DIR}/system_wrapper.bit"

# Primary Bootmode value
DEFAULT_HW_BOOT_MODE = "3"

# Update bootbin to use proper device tree
BIF_PARTITION_IMAGE[device-tree] = "${DTB_FILE_PATH}"

# Remap boot files to ensure the right device tree is listed first
IMAGE_BOOT_FILES =+ "devicetree/${@os.path.basename(d.getVar('CONFIG_DTFILE').replace('.dts', '.dtb'))}"

#### No additional settings should be after the Postamble
#### Postamble
PACKAGE_EXTRA_ARCHS:append = "${@['', ' genesyszu_5ev']['genesyszu-5ev' != '${MACHINE}']}"
```
